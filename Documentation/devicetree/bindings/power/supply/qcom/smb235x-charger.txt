## Documentation/devicetree/bindings/power/supply/qcom/smb235x-charger.txt
```
Qualcomm Technologies, Inc. SMB235x Charger Specific Bindings

SMB235x is a battery charger PMIC that can support charging
a 2S battery pack. It also supports Type-C and USB PD as
charger input. It can be controlled with either I2C bus or
SPMI bus with different variant.

Charger specific properties:
- compatible
  Usage:      required
  Value type: string
  Definition: "qcom,smb235x-charger".

- interrupt-parent
  Usage:      optional
  Value type: phandle
  Definition: The interrupt parent which generates the summary
              interrupt for the corresponding interrupts inside
              SMB235x peripherals.

- qcom,fv-max-uv
  Usage:      optional
  Value type: u32
  Definition: The maximum float voltage in uV for the given battery.

- qcom,fcc-max-ua
  Usage:      optional
  Value type: u32
  Definition: The maximum battery current in uA for the given battery.

- qcom,trickle-current-ua
  Usage:      optional
  Value type: u32
  Definition: The charge current in uA for charger module working
              in trickle charging mode while the battery voltage is
              pretty low (or just recovered from dead).

- qcom,precharge-current-ua
  Usage:      optional
  Value type: u32
  Definition: The charge current in uA for charger module working in
              pre-charge mode while battery voltage is low but higher
              than the trickle charging threshold.

- qcom,termination-current-ua
  Usage:      optional
  Value type: u32
  Definition: The charging current threshold in uA for charge module
              to stop charging automatically.

- qcom,auto-recharge-soc
  Usage:      optional
  Value type: u32
  Definition: The battery SoC threshold in percentage used for charger
              module to resume charging when the battery SoC dropped
              below that level after charging is complete.

- qcom,chg-inhibit-threshold-uv
  Usage:      optional
  Value type: u32
  Definition: The battery voltage threshold in uV for charger module to
              enter into inhibit mode (not charging).

Peripheral specific properties:
- interrupts
  Usage:      required
  Value type: <prop-encoded-array>
  Definition: Peripheral interrupt specifier.

- interrupt-names
  Usage:      required
  Value type: <stringlist>
  Definition: Interrupt names.  This list must match up 1-to-1 with the
              interrupts specified in the 'interrupts' property.

- tcpm-psy-name
  Usage:      required
  Value type: string
  Definition: A part of tcpm power supply name, driver will concatenate it
              and basic tcpm name to generate the complete tcpm power supply
              name. This name changes depending on the devicetree node definition.

=======
Example
=======

smb2352: qcom,smb2352@71 {
	compatible = "qcom,i2c-pmic";
	reg = <0x71>;
	#address-cells = <1>;
	#size-cells = <0>;
	interrupt-controller;
	#interrupt-cells = <3>;
	interrupt-parent = <&tlmm>;
	interrupts = <80 IRQ_TYPE_LEVEL_LOW>;
	qcom,periph-map = <0x6 0xa 0x10 0x11 0x12 0x13 0x15 0x16 0x17>;
	pinctrl-names = "default";
	pinctrl-0 = <&smb2352_gpio_int_active>;

	revid@100 {
		compatible = "qcom,qpnp-revid";
		reg = <0x100>;
	};

	smb2352_charger: smb2352-charger {
		compatible = "qcom,smb235x-charger";
		#address-cells = <1>;
		#size-cells = <1>;
		interrupt-parent = <&smb2352>;
		tcpm-psy-name = "78b7000.i2c:qcom,smb2352@71:typec@1500";

		interrupts = <0x10 0x0 IRQ_TYPE_EDGE_RISING>,
			<0x10 0x1 IRQ_TYPE_EDGE_RISING>,
			<0x11 0x0 IRQ_TYPE_EDGE_RISING>,
			<0x11 0x5 IRQ_TYPE_LEVEL_HIGH>;

		interrupt-names = "chgr-error",
			"chgr-state-change",
			"otg-fail",
			"input-current-limit";
	};
};
```
